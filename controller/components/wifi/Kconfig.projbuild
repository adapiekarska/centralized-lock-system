## controller/components/wifi/Kconfig.projbuild
```kconfig
menu "Wifi configuration"

    config WIFI_SSID
        string "WiFi SSID"
        help
            Enter SSID for WiFi network used in wireless data exchange 

    config WIFI_PASS
        string "WiFi Password"
        help
            Enter password for WiFi network used in wireless data exchange

    config SERVER_ADDR
        string "Server IP Address"
        help
            Enter the IP address of the authentication server

    config SERVER_PORT
        int "Server TCP port"
        range 1 65535
        default 3333
        help
            Enter the TCP port the server is listening on

    config TLS_ENABLED
        boolean "Enable TLS"
        default y
        help
            Enable TLS for wireless data transfer

endmenu
```

## controller/main/Kconfig.projbuild
```kconfig
menu "General controller configuration"

    config LOCK_ID
        int "Lock ID"
        range 0 2147483647
        default 1
        help
            Enter the unique ID which will be used to identify this lock

endmenu
```
